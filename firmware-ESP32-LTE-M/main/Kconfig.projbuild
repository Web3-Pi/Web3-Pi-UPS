## firmware-ESP32-LTE-M/main/Kconfig.projbuild
```kconfig
menu "Web3 Pi modem UART"

    choice WUPS_MODEM_UART_SPEED
        prompt "SIM7080G UART speed"
        default WUPS_MODEM_UART_115200
        help
            The firmware detects 115200/230400 before PPP, plus 921600
            for return from the previous experiment,
            then synchronizes the ESP32 UART and the modem's saved AT+IPR.
            Select 115200 to restore the modem before installing old firmware.
            The selected rate stays fixed during operation.

        config WUPS_MODEM_UART_115200
            bool "115200 bit/s (baseline / restore)"

        config WUPS_MODEM_UART_230400
            bool "230400 bit/s (research)"

    endchoice

    config WUPS_MODEM_UART_BAUD
        int
        default 230400 if WUPS_MODEM_UART_230400
        default 115200

    config WUPS_MODEM_TX_UNBUFFERED
        bool "Use unbuffered modem TX (TX0 experiment)"
        default n
        help
            Compare the SDK's FIFO-semaphore TX path with the default
            512-byte TX ring. Keep baud, RX buffers and task settings fixed.

    config WUPS_MODEM_TX_BUFFER_SIZE
        int
        default 0 if WUPS_MODEM_TX_UNBUFFERED
        default 512

    config WUPS_MODEM_CORE1
        bool "Pin PPP supervisor and modem UART1 task to CPU1 (B-UART)"
        default n
        depends on !FREERTOS_SMP && FREERTOS_NUMBER_OF_CORES = 2
        help
            Pin ppp_sup and the esp_modem UART1 event task to CPU1. UART1
            driver creation is synchronous in the pinned supervisor, so its
            interrupt is also allocated on CPU1. Keep baud, RX/TX buffers,
            task priorities and all other task affinities unchanged.
            With performance diagnostics enabled, task affinity and the
            interrupt allocation table are logged on every DCE creation.

    config WUPS_PERF_DIAG
        bool "Sparse CPU, memory and transport diagnostics"
        default n
        depends on FREERTOS_GENERATE_RUN_TIME_STATS
        depends on FREERTOS_RUN_TIME_STATS_USING_ESP_TIMER
        depends on FREERTOS_RUN_TIME_COUNTER_TYPE_U64
        depends on !FREERTOS_SMP
        help
            Report 30-second per-core idle deltas and bounded UART/PPP
            aggregates. Enable only in research images; hooks never log
            payloads and leave transport return values unchanged.

    config WUPS_PERF_BENCH
        bool "One-shot synthetic HTTPS duplex benchmark"
        default n
        depends on WUPS_PERF_DIAG
        help
            After a healthy MQTT uplink and a quiet baseline, download and
            upload 512 KiB concurrently using Cloudflare speedtest endpoints.
            Uploads contain only synthetic zero bytes. Runs once per boot;
            leave disabled in images intended for normal device operation.

    config WUPS_PERF_RECOVERY_BENCH
        bool "Two orderly modem reconnect cycles after duplex benchmark"
        default n
        depends on WUPS_PERF_BENCH
        help
            Request two owner-controlled modem teardown/recreate cycles
            after the synthetic duplex transfer. This exercises normal DCE
            recreation, not RF fault simulation. Keep disabled outside the
            research comparison; no asynchronous power-key toggles.

endmenu
```

## tools/mqtt_target_fixture/sdkconfig.defaults
```kconfig
CONFIG_IDF_TARGET="esp32s3"
CONFIG_ESPTOOLPY_FLASHSIZE_4MB=y
CONFIG_ESP_DEFAULT_CPU_FREQ_MHZ_240=y
CONFIG_ESP_CONSOLE_USB_SERIAL_JTAG=y
CONFIG_LWIP_NETIF_LOOPBACK=y
CONFIG_LWIP_LOOPBACK_MAX_PBUFS=16
CONFIG_LWIP_TCP_SND_BUF_DEFAULT=2880
CONFIG_LWIP_TCP_WND_DEFAULT=2880
CONFIG_LWIP_TCP_RECVMBOX_SIZE=4
CONFIG_MBEDTLS_TLS_SERVER_AND_CLIENT=y
CONFIG_MBEDTLS_HAVE_TIME_DATE=y
CONFIG_MBEDTLS_SSL_PROTO_TLS1_2=y
CONFIG_MBEDTLS_SSL_PROTO_TLS1_3=n
CONFIG_ESP_MAIN_TASK_STACK_SIZE=8192
CONFIG_FREERTOS_HZ=1000
CONFIG_MQTT_PROTOCOL_311=y
CONFIG_LOG_DEFAULT_LEVEL_INFO=y
CONFIG_PARTITION_TABLE_SINGLE_APP_LARGE=y
```

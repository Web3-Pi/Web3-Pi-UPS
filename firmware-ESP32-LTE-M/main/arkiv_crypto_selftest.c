#include "arkiv_crypto_selftest.h"

#include <string.h>
#include "esp_log.h"

#include "arkiv_crypto/secp256k1.h"
#include "arkiv_crypto/aead.h"

/* Golden vectors generated by components/arkiv_crypto/test/gen_kat.mjs and
 * cross-verified there against node:crypto / OpenSSL / @noble/curves. These are
 * data-only headers (static const arrays), so including them here causes no
 * symbol clash and pins the firmware path to the same bytes the reader uses. */
#include "../components/arkiv_crypto/test/kat_vectors.h"
#include "../components/arkiv_crypto/test/hkdf_vectors.h"
#include "../components/arkiv_crypto/test/gcm_vectors.h"
#include "../components/arkiv_crypto/test/seal_vectors.h"

#define TAG "arkiv_selftest"

bool arkiv_crypto_selftest(void)
{
    int fails = 0;

    /* 1. ECDH — micro-ecc on-device == OpenSSL/@noble golden X. */
    uint8_t x[32];
    if (arkiv_secp256k1_ecdh(kat_dev_priv, kat_owner_pub, x) != 0 ||
        memcmp(x, kat_expected_shared_x, 32) != 0) {
        ESP_LOGE(TAG, "ECDH  FAIL"); fails++;
    } else {
        ESP_LOGI(TAG, "ECDH  ok");
    }

    /* 2. HKDF — mbedtls-SHA256 HMAC chain == node hkdfSync golden OKM. */
    uint8_t okm[32];
    if (arkiv_hkdf_sha256(kat_hkdf_ikm, sizeof(kat_hkdf_ikm),
                          (const uint8_t *)kat_hkdf_salt, strlen(kat_hkdf_salt),
                          (const uint8_t *)kat_hkdf_info, strlen(kat_hkdf_info),
                          okm, sizeof(okm)) != 0 ||
        memcmp(okm, kat_hkdf_expected_okm, 32) != 0) {
        ESP_LOGE(TAG, "HKDF  FAIL"); fails++;
    } else {
        ESP_LOGI(TAG, "HKDF  ok");
    }

    /* 3. AES-256-GCM — mbedtls + ESP32 HW AES == node aes-256-gcm golden ct/tag.
     *    This is the link that could only be confirmed on real silicon. */
    uint8_t ct[64], tag[16];
    if (arkiv_aead_gcm_encrypt(kat_gcm_key, kat_gcm_nonce,
                               kat_gcm_aad, sizeof(kat_gcm_aad),
                               kat_gcm_pt, sizeof(kat_gcm_pt), ct, tag) != 0 ||
        memcmp(ct, kat_gcm_ct, sizeof(kat_gcm_pt)) != 0 ||
        memcmp(tag, kat_gcm_tag, 16) != 0) {
        ESP_LOGE(TAG, "GCM   FAIL"); fails++;
    } else {
        ESP_LOGI(TAG, "GCM   ok");
    }

    /* 4. Full seal — derive K_dir + arkiv_aead_seal == byte-exact JS body. */
    uint8_t kdir[32], body[256];
    size_t  blen = 0;

    if (arkiv_aead_derive_key(seal_shared_x, seal_owner_lower, seal_devpub_lower,
                              SEAL_TLM_TYPETAG, SEAL_TLM_EPOCH, kdir) != 0 ||
        memcmp(kdir, seal_tlm_kdir, 32) != 0) {
        ESP_LOGE(TAG, "SEAL  FAIL (tlm K_dir)"); fails++;
    } else if (arkiv_aead_seal(SEAL_TLM_TYPETAG, SEAL_TLM_EPOCH, SEAL_TLM_SEQ, kdir,
                               seal_device_id, seal_tlm_entity, NULL,
                               seal_tlm_pt, sizeof(seal_tlm_pt),
                               body, sizeof(body), &blen) != 0 ||
               blen != sizeof(seal_tlm_body) ||
               memcmp(body, seal_tlm_body, sizeof(seal_tlm_body)) != 0) {
        ESP_LOGE(TAG, "SEAL  FAIL (tlm body)"); fails++;
    } else if (arkiv_aead_derive_key(seal_shared_x, seal_owner_lower, seal_devpub_lower,
                                     SEAL_ACK_TYPETAG, SEAL_ACK_EPOCH, kdir) != 0 ||
               arkiv_aead_seal(SEAL_ACK_TYPETAG, SEAL_ACK_EPOCH, SEAL_ACK_SEQ, kdir,
                               seal_device_id, seal_ack_entity, seal_ack_cmdid,
                               seal_ack_pt, sizeof(seal_ack_pt),
                               body, sizeof(body), &blen) != 0 ||
               blen != sizeof(seal_ack_body) ||
               memcmp(body, seal_ack_body, sizeof(seal_ack_body)) != 0) {
        ESP_LOGE(TAG, "SEAL  FAIL (ack body)"); fails++;
    } else {
        ESP_LOGI(TAG, "SEAL  ok (tlm + ack body byte-exact)");
    }

    if (fails == 0) {
        ESP_LOGI(TAG, "===== ARKIV CRYPTO SELFTEST PASS "
                      "(mbedtls + HW AES == host/JS golden vectors) =====");
        return true;
    }
    ESP_LOGE(TAG, "===== ARKIV CRYPTO SELFTEST FAILED: %d stage(s) =====", fails);
    return false;
}
